
/*
Experiment: MQTT-based Home Alarm System generated by ChatGPT
*/
#include <WiFi.h>
#include <PubSubClient.h>

#define WIFI_SSID "YOUR_WIFI"
#define WIFI_PASS "YOUR_PASSWORD"

#define MQTT_HOST "192.168.1.50"
#define MQTT_PORT 1883

#define DOOR_PIN 27
#define ALARM_LED_PIN 2

const char* TOPIC_DOOR  = "home/alarm/door";
const char* TOPIC_STATE = "home/alarm/state";
const char* TOPIC_CMD   = "home/alarm/cmd";

WiFiClient wifiClient;
PubSubClient mqtt(wifiClient);

QueueHandle_t doorQueue;
QueueHandle_t alarmCmdQueue;

enum AlarmState {
  ALARM_UNLOCKED,
  ALARM_LOCKED
};

volatile AlarmState alarmState = ALARM_UNLOCKED;

void mqttCallback(char* topic, byte* payload, unsigned int length) {
  String msg;

  for (unsigned int i = 0; i < length; i++) {
    msg += (char)payload[i];
  }

  if (String(topic) == TOPIC_CMD) {
    if (msg == "LOCK") {
      AlarmState cmd = ALARM_LOCKED;
      xQueueSend(alarmCmdQueue, &cmd, 0);
    } else if (msg == "UNLOCK") {
      AlarmState cmd = ALARM_UNLOCKED;
      xQueueSend(alarmCmdQueue, &cmd, 0);
    }
  }
}

void connectWiFi() {
  if (WiFi.status() == WL_CONNECTED) return;

  WiFi.begin(WIFI_SSID, WIFI_PASS);

  uint32_t start = millis();
  while (WiFi.status() != WL_CONNECTED && millis() - start < 5000) {
    vTaskDelay(pdMS_TO_TICKS(100));
  }
}

void connectMQTT() {
  if (mqtt.connected()) return;

  String clientId = "esp32-alarm-" + String((uint32_t)ESP.getEfuseMac(), HEX);

  if (mqtt.connect(clientId.c_str())) {
    mqtt.subscribe(TOPIC_CMD);
    mqtt.publish(TOPIC_STATE, alarmState == ALARM_LOCKED ? "LOCKED" : "UNLOCKED", true);
  }
}

void mqttTask(void* parameter) {
  mqtt.setServer(MQTT_HOST, MQTT_PORT);
  mqtt.setCallback(mqttCallback);

  uint32_t lastReconnectAttempt = 0;

  while (true) {
    connectWiFi();

    if (WiFi.status() == WL_CONNECTED) {
      if (!mqtt.connected()) {
        if (millis() - lastReconnectAttempt > 5000) {
          lastReconnectAttempt = millis();
          connectMQTT();
        }
      } else {
        mqtt.loop();
      }
    }

    vTaskDelay(pdMS_TO_TICKS(10));
  }
}

void doorSensorTask(void* parameter) {
  bool lastStableState = digitalRead(DOOR_PIN);
  bool lastReading = lastStableState;
  uint32_t lastChangeTime = millis();

  while (true) {
    bool reading = digitalRead(DOOR_PIN);

    if (reading != lastReading) {
      lastReading = reading;
      lastChangeTime = millis();
    }

    if ((millis() - lastChangeTime) > 50 && reading != lastStableState) {
      lastStableState = reading;

      bool doorOpen = lastStableState == HIGH;
      xQueueSend(doorQueue, &doorOpen, 0);
    }

    vTaskDelay(pdMS_TO_TICKS(20));
  }
}

void alarmTask(void* parameter) {
  bool doorOpen;
  AlarmState cmd;

  while (true) {
    if (xQueueReceive(alarmCmdQueue, &cmd, 0) == pdTRUE) {
      alarmState = cmd;
      digitalWrite(ALARM_LED_PIN, alarmState == ALARM_LOCKED ? HIGH : LOW);

      if (mqtt.connected()) {
        mqtt.publish(TOPIC_STATE, alarmState == ALARM_LOCKED ? "LOCKED" : "UNLOCKED", true);
      }
    }

    if (xQueueReceive(doorQueue, &doorOpen, 0) == pdTRUE) {
      if (mqtt.connected()) {
        mqtt.publish(TOPIC_DOOR, doorOpen ? "OPEN" : "CLOSED", true);
      }

      if (doorOpen && alarmState == ALARM_LOCKED) {
        if (mqtt.connected()) {
          mqtt.publish("home/alarm/event", "DOOR_OPEN_WHILE_LOCKED");
        }
      }
    }

    vTaskDelay(pdMS_TO_TICKS(20));
  }
}

void setup() {
  Serial.begin(115200);

  pinMode(DOOR_PIN, INPUT_PULLUP);
  pinMode(ALARM_LED_PIN, OUTPUT);

  doorQueue = xQueueCreate(5, sizeof(bool));
  alarmCmdQueue = xQueueCreate(3, sizeof(AlarmState));

  xTaskCreatePinnedToCore(mqttTask, "MQTT Task", 4096, NULL, 1, NULL, 0);
  xTaskCreatePinnedToCore(doorSensorTask, "Door Sensor Task", 2048, NULL, 2, NULL, 1);
  xTaskCreatePinnedToCore(alarmTask, "Alarm Task", 3072, NULL, 2, NULL, 1);
}

void loop() {
  vTaskDelay(pdMS_TO_TICKS(1000));
}